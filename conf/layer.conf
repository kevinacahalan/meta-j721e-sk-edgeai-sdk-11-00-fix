## conf/layer.conf
```bitbake
BBPATH .= ":${LAYERDIR}"

BBFILES += "${LAYERDIR}/recipes*/*/*.bb ${LAYERDIR}/recipes*/*/*.bbappend"

BBFILE_COLLECTIONS += "meta-j721e-sk-edgeai-sdk-11-00-fix"
BBFILE_PATTERN_meta-j721e-sk-edgeai-sdk-11-00-fix := "^${LAYERDIR}/"
BBFILE_PRIORITY_meta-j721e-sk-edgeai-sdk-11-00-fix = "90"

LAYERDEPENDS_meta-j721e-sk-edgeai-sdk-11-00-fix = "core meta-edgeai"
LAYERSERIES_COMPAT_meta-j721e-sk-edgeai-sdk-11-00-fix = "scarthgap"
```
